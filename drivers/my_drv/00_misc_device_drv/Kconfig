## drivers/my_drv/00_misc_device_drv/Kconfig
```kconfig
menu "Test Misc Device support"

config TEST_MISC_DEVICE_DRV
    bool "Test misc device drv support"
    default y
    depends on MY_TEST_DRIVER
    help
	  This option enables support for the test misc device drv
	  on my test driver.

endmenu
```

## drivers/my_drv/01_chrdev/Kconfig
```kconfig
menu "Test Chrdev support"

config TEST_CHRDEV
    bool "Test Chrdev support"
    default y
    depends on MY_TEST_DRIVER
    help
        This option enables support for the test chrdev
        on my test driver.
endmenu
```

## drivers/my_drv/02_platform_led_drv/Kconfig
```kconfig
menu "Test Platform Led Driver support"


config TEST_PLATFORM_LED
	bool "Test Platform Led Driver support"
	default y
	depends on MY_TEST_DRIVER
	help
	  This option enables support for the test platform led 
	  on my test driver.



endmenu
```

## drivers/my_drv/Kconfig
```kconfig
#
# my test driver configuration
#

menu "My Test Driver support"

config MY_TEST_DRIVER
    bool "My Test Driver support"
	default y


if MY_TEST_DRIVER

source "drivers/my_drv/00_misc_device_drv/Kconfig"
source "drivers/my_drv/01_chrdev/Kconfig"
source "drivers/my_drv/02_platform_led_drv/Kconfig"

source "drivers/my_drv/test_drv/Kconfig"


endif

endmenu
```

## drivers/my_drv/test_drv/Kconfig
```kconfig
menu "All Test Drv support"


config ALL_TEST_DRIVER
	bool "all test driver support"
	default y
	depends on MY_TEST_DRIVER
	help
	  This option enables support for the all test driver
	  on my test driver.



endmenu
```
