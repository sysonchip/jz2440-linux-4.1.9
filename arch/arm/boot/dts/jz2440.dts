// SPDX-License-Identifier: GPL-2.0
/*
 * SAMSUNG SMDK2440 board device tree source
 *
 * Copyright (c) 2018 weidongshan@qq.com
 * dtc -I dtb -O dts -o jz2440.dts jz2440.dtb
 */
 
#define S3C2410_GPA(_nr)	((0<<16) + (_nr))
#define S3C2410_GPB(_nr)	((1<<16) + (_nr))
#define S3C2410_GPC(_nr)	((2<<16) + (_nr))
#define S3C2410_GPD(_nr)	((3<<16) + (_nr))
#define S3C2410_GPE(_nr)	((4<<16) + (_nr))
#define S3C2410_GPF(_nr)	((5<<16) + (_nr))
#define S3C2410_GPG(_nr)	((6<<16) + (_nr))
#define S3C2410_GPH(_nr)	((7<<16) + (_nr))
#define S3C2410_GPJ(_nr)	((8<<16) + (_nr))
#define S3C2410_GPK(_nr)	((9<<16) + (_nr))
#define S3C2410_GPL(_nr)	((10<<16) + (_nr))
#define S3C2410_GPM(_nr)	((11<<16) + (_nr))

/*
#define EXYNOS_PIN_FUNC_INPUT     0
#define EXYNOS_PIN_FUNC_OUTPUT        1
#define EXYNOS_PIN_FUNC_2     2
#define EXYNOS_PIN_FUNC_3     3
#define EXYNOS_PIN_FUNC_4     4
#define EXYNOS_PIN_FUNC_5     5
#define EXYNOS_PIN_FUNC_6     6
#define EXYNOS_PIN_FUNC_EINT      0xf
#define EXYNOS_PIN_FUNC_F     EXYNOS_PIN_FUNC_EINT
*/

/dts-v1/;

/ {
	model = "SMDK24440";
	compatible = "samsung,smdk2440";

	#address-cells = <1>;
	#size-cells = <1>;
		
	memory@30000000 {
		device_type = "memory";
		reg =  <0x30000000 0x4000000>;
	};
/*
	cpus {
		cpu {
			compatible = "arm,arm926ej-s";
		};
	};
*/	
	chosen {
		bootargs = "noinitrd root=/dev/mtdblock4 rw init=/linuxrc console=ttySAC0,115200";
	};

/*	
	led {
		compatible = "jz2440_led";
		pin = <S3C2410_GPF(6)>;
	};
*/

	my_led:led{
		#address-cells = <1>;
		#size-cells = <1>;

		compatible = "led";
		reg =  <0x56000050 0x0000004>;

		//pinctrl-names = "default","myled_off";
		//pinctrl-0 = <&myled_on>;
        //pinctrl-1 = <&myled_off>;
	};

};


&my_led{
	compatible = "my_led_test";
	status = "okay";
};

